## CMakeLists.txt
```
cmake_minimum_required(VERSION 3.13.1)

include($ENV{ZEPHYR_BASE}/cmake/app/boilerplate.cmake NO_POLICY_SCOPE)
project(just_works)

FILE(GLOB app_sources src/*.c)
target_sources(app PRIVATE
  ${app_sources}
    src/services/custom_service.c
  )

zephyr_library_include_directories(src)
```

## sample.yaml
```
sample:
  name: test application
tests:
  sample.testapp:
    filter: CONFIG_UART_CONSOLE and CONFIG_SERIAL_SUPPORT_INTERRUPT
    tags: testapp
    harness: keyboard
```

## prj.conf
```kconfig
# needed to ensure keys are persisted
CONFIG_BT=y
CONFIG_FLASH=y
CONFIG_FLASH_PAGE_LAYOUT=y
CONFIG_FLASH_MAP=y
CONFIG_FCB=y
CONFIG_SETTINGS=y
CONFIG_BT_SETTINGS=y
CONFIG_BT_PERIPHERAL=y
CONFIG_BT_GATT_DYNAMIC_DB=y
CONFIG_BT_DEVICE_NAME="LVL1NONE"

#BT CONFIGS FOR DIS PROFILE STARTS
#CONFIG_BT=y
#CONFIG_BT_PERIPHERAL=y

#CONFIG_BT_DIS=y
#CONFIG_BT_DIS_PNP=n
#CONFIG_BT_DIS_MODEL="Zephyr Model"
#CONFIG_BT_DIS_MANUF="Zephyr"
#CONFIG_BT_DIS_SERIAL_NUMBER=y
#CONFIG_BT_DIS_FW_REV=y
#CONFIG_BT_DIS_HW_REV=y
#CONFIG_BT_DIS_SW_REV=y
#CONFIG_BT_DIS_SERIAL_NUMBER_STR="Zephyr Serial"
#CONFIG_BT_DIS_FW_REV_STR="Zephyr Firmware"
#CONFIG_BT_DIS_HW_REV_STR="Zephyr Hardware"
#CONFIG_BT_DIS_SW_REV_STR="Zephyr Software"

#CONFIG_BT_DEVICE_NAME="DIS peripheral"


# Below is setup to let DIS information be read from settings
CONFIG_BT_SETTINGS=y
#CONFIG_SETTINGS_RUNTIME=y
#CONFIG_SETTINGS=y
#CONFIG_SETTINGS_NONE=y

#CONFIG_BT_DIS_SETTINGS=y
#CONFIG_BT_DIS_STR_MAX=21
#BT CONFIGS FOR DIS PROFILE ENDS

# Below are used for Test APP STARTS HERE
CONFIG_CONSOLE_SUBSYS=y
CONFIG_CONSOLE_GETLINE=y
# Below are used for Test APP ENDS HERE

#BT SECURE Connection Starts

CONFIG_BT_SMP=y

# enable the possibility of LE Secure Connections
CONFIG_BT_TINYCRYPT_ECC=y

# specify Secure Connections Only mode
CONFIG_BT_SMP_SC_ONLY=y
#BT SECURE Connection Ends

#Want to use a Static Random BT Address
CONFIG_BT_PRIVACY=n
#End Want to use a Static Random BT Address
```

## src/main.c
```c
/*
 * Copyright (c) Venkatesan Madappan
 *
 */

#include "bt_specific.h"
#include <services/custom_service.h>
#include "test_app.h"


/* size of stack area used by each thread */
#define STACKSIZE 1024

/* scheduling priority used by each thread */
#define PRIORITY 7

static struct bt_conn_cb conn_callbacks = {
    .connected = connected,
    .disconnected = disconnected,
    .security_changed = security_level_changed
};

// callbacks for pairing - IO Capabilities
static struct bt_conn_auth_cb pairing_cb_display = {
      .passkey_display = pairing_passkey_display,
      .passkey_confirm = auth_confirm,
      .cancel = auth_cancel,
};

static void bt_ready_callback(int err)
{
	if(err)
	{
		printk("Bluetooth init failed (err %d) \n", err);
	}
	custom_service_init();
	
	if(IS_ENABLED(CONFIG_SETTINGS))
	{
		settings_load();
	}
	/*
	err = bt_le_adv_start(BT_LE_ADV_CONN, ad, ARRAY_SIZE(ad), NULL, 0);
	if(err)
	{
		printk("Advertising Failed to start (err %d)\n", err);
		return;
	}
	printk("Advertising Started Successfully \n");
	*/
}
void main(void)
{
    int err;
    
    err = bt_enable(bt_ready_callback);
    
    if (err) {
        printk("Bluetooth init failed (err %d)\n", err);
        return;
    }
    
    clear_all_bonds();
    
    bt_conn_cb_register(&conn_callbacks);
    
    // callback for authentication step
    bt_conn_auth_cb_register(&pairing_cb_display);

    printk("Read Thread Going to Start\n");
    console_getline_init();
}

K_THREAD_DEFINE(test_app_read, STACKSIZE, serial_read_thread, NULL, NULL, NULL,
        PRIORITY, 0, 0);
```

## src/bt_specific.c
```c
#include "bt_specific.h"
#include "zephyr_includes.h"
#include <services/custom_service.h>

struct bt_conn *default_conn;
bool authenticating = false;

#define DEVICE_NAME "VENKAT CUSTOM"
#define DEVICE_NAME_LEN (sizeof(DEVICE_NAME)-1)

static const struct bt_data ad[] = {
		BT_DATA_BYTES(BT_DATA_FLAGS, (BT_LE_AD_GENERAL | BT_LE_AD_NO_BREDR)),
		BT_DATA(BT_DATA_NAME_COMPLETE, DEVICE_NAME, DEVICE_NAME_LEN),
};

/* Framework Message handling Ends here */

/*
 * start_advertisement
 * Framework Request to start the Advertisement
 */
 
void start_advertisement(void)
{
    int err;
    err = bt_le_adv_start(BT_LE_ADV_CONN, ad, ARRAY_SIZE(ad), NULL, 0);
    if (err) 
        printk("ADVERTISE_FAILED\n");
    else
        printk("ADVERTISE_SUCCESSFULL\n");
}

/*
 * advertise_stop
 * Framework Request to stop the Advertisement
 */
 
void advertise_stop(void)
{
    bt_le_adv_stop();
    printk("ADVERTISE_STOP_SUCCESSFULL\n");
}

/*
 * get_security_level
 * Get the Security Level from the BT Stack
 */
 
void get_security_level()
{
    bt_security_t bt_sec;
    bt_sec = bt_conn_get_security(default_conn);
    if (bt_sec == BT_SECURITY_L1)
    {
        printk("BT_SECURITY_L1\n");
    }
    else if (bt_sec == BT_SECURITY_L4)
    {
        printk("BT_SECURITY_L4\n");
    }
    else
    {

        printk("Unknown Security Level %d\n",bt_sec);
    }
}

/*
 * passkey_confirm_received
 * Pass Key Confirmation Displayed on the Framework
 */
 
 void passkey_confirm_received(void)
{
    bt_conn_auth_passkey_confirm(default_conn);
}

void cancel_auth(void)
{
    auth_cancel(default_conn);
}

 /* Framework Message handling Ends here */
 
 /* Bluetooth Stack Call back Starts here */
 

/*
 * connected
 * BT Stack Connection Call back from Zehpyr Stack
 */
 
void connected(struct bt_conn *conn, uint8_t err)
{
    if (err) {
        printk("Connection failed (err 0x%02x)\n", err);
    } else {
        printk("CONNECT\n");
        default_conn = bt_conn_ref(conn);
        bt_conn_set_security(default_conn, BT_SECURITY_L4);
    }
}

/*
 * disconnected
 * BT Stack Connection Call back from Zehpyr Stack
 */
 
void disconnected(struct bt_conn *conn, uint8_t reason)
{
    printk("DISCONNECT\n");
    if (default_conn)
    {
        bt_conn_unref(default_conn);
        default_conn = NULL;
    }
}

/*
 * security_level_changed
 * BT Stack Connection Call back from Zehpyr Stack
 */
 
void security_level_changed(struct bt_conn *conn, bt_security_t level, enum bt_security_err err)
{
    printk("Security Level Changed to : %d\n", level);
    if(level==1)
    {
        printk("BT_SECURITY_L1\n");
    }else if (level==4)
    {
        printk("BT_SECURITY_L4\n");
    }else{
        printk("\nHMM Something !! Wrong security_level_changed to %d\n", level);
    } 
}

/*
 * pairing_passkey_display
 * BT Stack Security Call back from Zehpyr Stack
 */

void pairing_passkey_display(struct bt_conn *conn, unsigned int passkey)
{
   char addr[BT_ADDR_LE_STR_LEN];
   bt_addr_le_to_str(bt_conn_get_dst(conn), addr, sizeof(addr));
   printk("Passkey for %s: %06u\n", addr, passkey);
}

/*
 * auth_confirm
 * BT Stack Security Call back from Zehpyr Stack
 */
 
void auth_confirm(struct bt_conn *conn, unsigned int passkey)
{
   default_conn = conn;
   char addr[BT_ADDR_LE_STR_LEN];
   char passkey_str[7];
   bt_addr_le_to_str(bt_conn_get_dst(conn), addr, sizeof(addr));
   snprintk(passkey_str, 7, "%06u", passkey);
   printk("%s: %s\n", addr, passkey_str);
   if(authenticating==true)
   {
     bt_conn_auth_passkey_confirm(default_conn);
   }
   else
   {
       auth_cancel(default_conn);
   }
   authenticating = false;
}

/*
 * auth_cancel
 * BT Stack Security Call back from Zehpyr Stack
 */
 
void auth_cancel(struct bt_conn *conn)
{
   printk("Pairing cancelled\n");
   bt_conn_auth_cancel(conn);
}



/*
 * clear_all_bonds
 * Clear all stored bonding information
 */
 
void clear_all_bonds()
{
    bt_unpair(BT_ID_DEFAULT, BT_ADDR_LE_ANY);
}
```

## src/bt_specific.h
```c
#ifndef __BT_SPECIFIC_H__
#define __BT_SPECIFIC_H__

#include <bluetooth/bluetooth.h>
#include <bluetooth/hci.h>
#include <bluetooth/conn.h>
#include <bluetooth/uuid.h>
#include <bluetooth/gatt.h>
#include <settings/settings.h>

void start_advertisement(void);
void advertise_stop(void);
void passkey_confirm_received(void);
void cancel_auth(void);
void get_security_level(void);
void set_security_level(bt_security_t);


void disconnected(struct bt_conn *conn, uint8_t reason);
void connected(struct bt_conn *conn, uint8_t err);

void clear_all_bonds();

void security_level_changed(struct bt_conn *conn, bt_security_t level, enum bt_security_err err);
void pairing_passkey_display(struct bt_conn *conn, unsigned int passkey);
void auth_cancel(struct bt_conn *conn);
void auth_confirm(struct bt_conn *conn, unsigned int passkey);
#endif
```

## src/test_app.c
```c
#include "test_app.h"
#include "zephyr_includes.h"
#include "bt_specific.h"

extern bool authenticating;

void serial_read_thread(void)
{
    while (1) {
        char *s = console_getline();
        if (strcmp(s, "ADVERTISE") == 0)
        {
           start_advertisement();
        }
        else if (strcmp(s, "ADVERTISE_STOP") == 0)
        {

           advertise_stop();
        }
        else if (strcmp(s, "AUTHENTICATION_CONFIRMED") == 0)
        {
           printk("Received Authentication_Confirmed \n");
           authenticating = true;
        }
        else if (strcmp(s, "AUTHENTICATION_CANCELED") == 0)
        {
            printk("Received Authentication Cancel \n");
            authenticating = false;
        }
        else if(strcmp(s, "CLEAR_BONDING") == 0)
        {
            printk("Clear Bonding \n");
            clear_all_bonds();
        }
        else if(strcmp(s, "GET_SECURITY_LEVEL") == 0)
        {
            get_security_level();
        }
		else if(strcmp(s, "EXPLORE_BT_ADDRESS")==0)
		{
			char addr_s[BT_ADDR_LE_STR_LEN];
			bt_addr_le_t addr = {0};
			size_t count = 1;
			bt_id_get(&addr, &count);
			bt_addr_le_to_str(&addr, addr_s, sizeof(addr_s));
		}
        else
            printk("%s\n", s);
    }
}
```

## src/test_app.h
```c
#ifndef __TEST_APP_H__
#define __TEST_APP_H__
#include <console/console.h>

void serial_read_thread(void);
#endif
```

## src/zephyr_includes.h
```c
#ifndef __ZEPHYR_INCLUDES__
#define __ZEPHYR_INCLUDES__
#include <zephyr/types.h>
#include <stddef.h>
#include <string.h>
#include <errno.h>
#include <sys/printk.h>
#include <sys/byteorder.h>
#include <zephyr.h>
#endif
```
